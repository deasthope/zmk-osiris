/ {
    chosen {
        zmk,kscan = &kscan0;
    };

    kscan0: kscan_0 {
        compatible = "zmk,kscan-gpio-matrix";
        wakeup-source;

        diode-direction = "col2row"; 

        // Rows
        row-gpios
            = <&pro_micro 3 (GPIO_ACTIVE_HIGH | GPIO_PULL_DOWN)>  // Row 1 (D3)
            , <&pro_micro 4 (GPIO_ACTIVE_HIGH | GPIO_PULL_DOWN)>  // Row 2 (D4)
            , <&pro_micro 5 (GPIO_ACTIVE_HIGH | GPIO_PULL_DOWN)>  // Row 3 (D5)
            , <&pro_micro 6 (GPIO_ACTIVE_HIGH | GPIO_PULL_DOWN)>  // Row 4 (D6)
            ;
        // Columns
        col-gpios
            = <&pro_micro  7 GPIO_ACTIVE_HIGH>  // Col 1 (D7)
            , <&pro_micro  8 GPIO_ACTIVE_HIGH>  // Col 2 (D8)
            , <&pro_micro  9 GPIO_ACTIVE_HIGH>  // Col 3 (D9)
            , <&pro_micro 21 GPIO_ACTIVE_HIGH>  // Col 4 (D21)
            , <&pro_micro 20 GPIO_ACTIVE_HIGH>  // Col 5 (D20)
            , <&pro_micro 19 GPIO_ACTIVE_HIGH>  // Col 6 (D19)
            , <&pro_micro 18 GPIO_ACTIVE_HIGH>  // Col 7 (D18)
            , <&pro_micro 15 GPIO_ACTIVE_HIGH>  // Col 8 (D15)
            , <&pro_micro 14 GPIO_ACTIVE_HIGH>  // Col 9 (D14)
            , <&pro_micro 16 GPIO_ACTIVE_HIGH>  // Col 10 (D16)
            , <&pro_micro 10 GPIO_ACTIVE_HIGH>  // Col 11 (D10)
            ;
    };
};
