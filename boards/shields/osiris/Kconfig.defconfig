## config/boards/shields/osiris/Kconfig.defconfig
```kconfig
if SHIELD_OSIRIS

config ZMK_KEYBOARD_NAME
    default "Osiris"

# Power management
config ZMK_PM
    default y

# Soft off behavior
config ZMK_SOFT_OFF
    default y
    
endif
```
